#include "Oled.h"

using namespace std;

/* Global variables */

volatile unsigned int *output = (volatile unsigned int *)0x80000a04;
volatile unsigned int *data = (volatile unsigned int *)0x80000a00;
volatile unsigned int *direction = (volatile unsigned int *)0x80000a08;

int characters[] = {
    0x00, 0x00, 0x00, 0x00, 0x00, 0x00, 0x00, 0x00, // 0x00, NUL
    0x00, 0x00, 0x00, 0x00, 0x00, 0x00, 0x00, 0x00, // 0x01, SOH
    0x00, 0x00, 0x00, 0x00, 0x00, 0x00, 0x00, 0x00, // 0x02, STX
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    0xAA, 0x55, 0xAA, 0x55, 0xAA, 0x55, 0xAA, 0x55  // 0x7F, DEL
};

void delay(clock_t time)
{
    clock_t start_time = clock();
    clock_t end_time = time + start_time;
    while (clock() != end_time)
        ;
}

void setPin(int pin, int value)
{
    switch (pin)
    {
    case CS:
        if (value)
            *output = *output | (0x01000000);
        else
            *output = *output & (0xFEFFFFFF);
        break;
    case SDIN:
        if (value)
            *output = *output | (0x02000000);
        else
            *output = *output & (0xFDFFFFFF);
        break;
    case SCLK:
        if (value)
            *output = *output | (0x08000000);
        else
            *output = *output & (0xF7FFFFFF);
        break;
    case DC:
        if (value)
            *output = *output | (0x10000000);
        else
            *output = *output & (0xEFFFFFFF);
        break;
    case RES:
        if (value)
            *output = *output | (0x20000000);
        else
            *output = *output & (0xDFFFFFFF);
        break;
    case VBATC:
        if (value)
            *output = *output | (0x40000000);
        else
            *output = *output & (0xBFFFFFFF);
        break;
    case VDDC:
        if (value)
            *output = *output | (0x80000000);
        else
            *output = *output & (0x7FFFFFFF);
        break;
    }
}

void sendCommand(unsigned command)
{
    /* CS must be low to send any data through the SPI (LOW) */
    setPin(CS, 0);
    /* DC must be low to send commands (LOW) */
    setPin(DC, 0);

    /* Loop used to send the entire command, bit by bit, MSB first */
    for (int i = 7; i >= 0; i--)
    {
        unsigned bit = (command >> i) & (0x00000001);
        /* Put the bit value in the SDIN pin */
        setPin(SDIN, bit);
        /* Wait for SDIN stabilize */
        delay(5);
        /* Send the bit in SDIN raising the clock to HIGH */
        setPin(SCLK, 1);
        /* Wait some time */
        delay(5);
        /* Set clock to low again */
        setPin(SCLK, 0);
        /* Wait some time before sending the next bit */
        delay(5);
    }

    /* CS is set to high to stop sending data through the SPI(HIGH) */
    setPin(CS, 1);
}

void sendData(char data)
{
    /* CS must be low to send any data through the SPI (LOW) */
    setPin(CS, 0);
    /* DC must be high to send data (HIGH) */
    setPin(DC, 1);

    /* Loop used to send the entire char, bit by bit, MSB first */
    for (int i = 7; i >= 0; i--)
    {
        unsigned bit = (data >> i) & (0x00000001);
        /* Put the bit value in the SDIN pin */
        setPin(SDIN, bit);
        /* Wait for SDIN stabilize */
        delay(5);
        /* Send the bit in SDIN raising the clock to HIGH */
        setPin(SCLK, 1);
        /* Wait some time */
        delay(5);
        /* Set clock to low again */
        setPin(SCLK, 0);
        /* Wait some time before sending the next bit */
        delay(5);
    }

    /* CS is set to high to stop sending data through the SPI(HIGH) */
    setPin(CS, 1);
}

void oledInit()
{
    /* Set initial value for some of the pins before starting the power-on sequence */
    setPin(VDDC, 1);
    setPin(RES, 1);
    setPin(VBATC, 1);
    setPin(CS, 1);
    setPin(SCLK, 0);

    *direction = 0xFFFFFFFF;

    /* Apply power to VDD (LOW) */
    setPin(VDDC, 0);
    delay(100000);
    /* Send display OFF command */
    sendCommand(0xAE);
    /* Reset the display */
    setPin(RES, 0);
    delay(100000);
    setPin(RES, 1);
    delay(100000);
    /* Set Charge Pump */
    sendCommand(0x8D);
    sendCommand(0x14);
    /* Set Pre-Charge Period */
    sendCommand(0xD9);
    sendCommand(0xF1);
    /* Apply power to VBAT */
    delay(1);
    setPin(VBATC, 0);
    /* Delay 100ms */
    delay(100000);
    /* Set Segment Re-Map */
    sendCommand(0xA1);
    /* Set COM Output Scan Direction */
    sendCommand(0xC8);
    /* Set COM Pins Hardware Configuration */
    sendCommand(0xDA);
    sendCommand(0x02);
    /* Send Display On Command */
    sendCommand(0xAF);
    delay(100000);
}

void oledOff()
{
    /* Send display OFF command */
    sendCommand(0xAE);
    /* Turn off power to VBAT (HIGH) */
    delay(1);
    setPin(VBATC, 1);
    delay(100000);
    /* Turn off power to VDD (HIGH) */
    setPin(VDDC, 1);
}

void setLine(unsigned line)
{
    sendCommand(0xb4 + line);
    sendCommand(0x00);
    sendCommand(0x10);
}

void oledFill()
{
    for (unsigned i = 0; i < 4; i++)
    {
        // Select Line
        setLine(i);
        // Fill the line
        for (unsigned j = 0; j < 128; j++)
            sendData(0xFF);
    }
}

void oledClear()
{
    for (unsigned i = 0; i < 4; i++)
    {
        // Select Line
        setLine(i);
        // Fill the line
        for (unsigned j = 0; j < 128; j++)
            sendData(0x00);
    }
}

void clearLine(int line)
{
    setLine(line);
    for (unsigned j = 0; j < 128; j++)
        sendData(0x00);
}

void printChar(char aux)
{
    for (unsigned i = 0; i < 8; i++)
        sendData(characters[8 * aux + i]);
}

void printString(char *string)
{
    for (unsigned i = 0; string[i] != 0; i++)
        printChar(string[i]);
}